## ad4696/zephyr/Kconfig
```kconfig
mainmenu "ADI AD4696 driver"

menu "Application configuration"

module = AD4696_DRIVER
module-str = AD4696 driver

config AD4696_DRIVER
	bool "Enable support for the demonstration out of tree driver"

source "subsys/logging/Kconfig.template.log_config"

endmenu

# source "Kconfig.zephyr"
```

## ble/zephyr/Kconfig
```kconfig
mainmenu "BLE SERVICE"

menu "Application configuration"

module = BLE_SERVICE
module-str = BLE service

config BLE_SERVICE
	bool "Enable support for the demonstration out of tree driver"

source "subsys/logging/Kconfig.template.log_config"

endmenu
```

## boards/arm/flexolink_ring/Kconfig.board
```kconfig
# Copyright (c) 2021 Nordic Semiconductor ASA
# SPDX-License-Identifier: Apache-2.0

config BOARD_FLEXOLINK_RING
	bool "FlexOLink Ring"
	depends on SOC_NRF52832_QFAA
```

## boards/arm/flexolink_ring/Kconfig.defconfig
```kconfig
# Copyright (c) 2021 Nordic Semiconductor ASA
# SPDX-License-Identifier: Apache-2.0

if BOARD_FLEXOLINK_RING

config BOARD
	default "flexolink_ring"

config BT_CTLR
   default BT

endif
```

## icm20948/zephyr/Kconfig
```kconfig
mainmenu "ICM20948 driver"

menu "Application configuration"

module = ICM20948_DRIVER
module-str = ICM20948 driver

config ICM20948_DRIVER
	bool "Enable support for the demonstration out of tree driver"

source "subsys/logging/Kconfig.template.log_config"

endmenu

# source "Kconfig.zephyr"
```
